## conf/layer.conf
```bitbake
# We have a conf and classes directory, append to BBPATH
BBPATH .= ":${LAYERDIR}"

BBFILES += "${LAYERDIR}/recipes-*/*.bb ${LAYERDIR}/recipes-*/*/*.bb ${LAYERDIR}/recipes-*/*/*.bbappend \
    ${LAYERDIR}/recipes-*/*/*/*.bb ${LAYERDIR}/recipes-*/*/*/*.bbappend"

BSP-BASE-GIGABLUE := '${@os.path.normpath("${LAYERDIR}/")}'
```

## conf/machine/gbquad4k.conf
```bitbake
#@TYPE: Machine
#@NAME: Gigablue Quad 4k
#@DESCRIPTION: Machine configuration for the Gigablue Quad 4k

SOC_FAMILY = "bcm7252s"
CHIPSET = "bcm7252s"

BRAND_OEM = "gigablue"
MACHINE_BRAND = "GigaBlue"
MACHINE_NAME = "UHD QUAD 4K"

FRIENDLY_FAMILY = "gb7252"
STB_PLATFORM = "gb7252"
MACHINE_MODEL = "gb7252"

KERNEL_FILE = "kernel.bin"
ROOTFS_FILE = "rootfs.tar.bz2"
MTD_BLACK = "mmcblk0"
MTD_BOOTFS = "mmcblk0p1"
MTD_ROOTFS = "mmcblk0p5"
MTD_KERNEL = "mmcblk0p4"

MACHINE_FEATURES += " HDMI HDMI-IN-FHD skins1080 ci wlan mmc colorlcd400 gigabluelcd gigabluelcd400 blindscan-dvbs blindscan-dvbc transcoding streamproxy dvb-c GB-cortexa15 gb-eglfs"
OPENPLI_FEATURES += " kodi openhbbtvbrowser"
DISTRO_FEATURES:remove = "x11 wayland directfb"

IMAGEDIR ?= "gigablue/quad4k"

SRCDATE_BOLT = "20181120"

require conf/machine/include/gigablue-gb7252.inc
```

## conf/machine/gbquad4kpro.conf
```bitbake
#@TYPE: Machine
#@NAME: Gigablue Quad 4k Pro
#@DESCRIPTION: Machine configuration for the Gigablue Quad 4k

SOC_FAMILY = "bcm7252s"
CHIPSET = "bcm7252s"

BRAND_OEM = "gigablue"
MACHINE_BRAND = "GigaBlue"
MACHINE_NAME = "UHD QUAD 4K PRO"

FRIENDLY_FAMILY = "gb7252"
STB_PLATFORM = "gb7252"
MACHINE_MODEL = "gb7252"

KERNEL_FILE = "kernel.bin"
ROOTFS_FILE = "rootfs.tar.bz2"
MTD_BLACK = "mmcblk0"
MTD_BOOTFS = "mmcblk0p1"
MTD_ROOTFS = "mmcblk0p5"
MTD_KERNEL = "mmcblk0p4"

MACHINE_FEATURES += " HDMI HDMI-IN-FHD skins1080 ci wlan mmc colorlcd400 gigabluelcd gigabluelcd400 blindscan-dvbs blindscan-dvbc transcoding streamproxy dvb-c GB-cortexa15 gb-eglfs initrd inibt"
OPENPLI_FEATURES += " kodi openhbbtvbrowser"
DISTRO_FEATURES:remove = "x11 wayland directfb"

IMAGEDIR ?= "gigablue/quad4kpro"

SRCDATE_BOLT = "20241204"

require conf/machine/include/gigablue-gb7252.inc
```

## conf/machine/gbtrio4k.conf
```bitbake
#@TYPE: Machine
#@NAME: gbtrio4k
#@DESCRIPTION: Machine configuration for the gbtrio4k

SOC_FAMILY = "hisi3798mv200"
CHIPSET = "Hi3798Mv200"
HICHIPSET = "3798mv200"

BRAND_OEM = "gigablue"
MACHINE_BRAND = "Gigablue"
MACHINE_NAME = "UHD Trio 4K"

KERNEL_FILE = "uImage"
ROOTFS_FILE = "rootfs.tar.bz2"
MTD_BLACK  = "mmcblk0"
MTD_KERNEL = "mmcblk0p12"
MTD_ROOTFS " "mmcblk0p16"

MACHINE_FEATURES += "hdmicec 7segment textlcd hisil mali emmc skins1080 transcoding multitranscoding himedia no-subssupport blindscan-dvbs blindscan dvb-c gfwol fastboot mountboot HDMI HDMISTANDBY AV_JACK"
OPENPLI_FEATURES += " qtplugins kodi"
DISTRO_FEATURES_remove = "x11 wayland directfb"

EXTRA_OECONF_append_pn-enigma2 = "--with-lcddev=/dev/null --with-alphablendingacceleration=always --with-blitaccelerationthreshold=250  --with-fillaccelerationthreshold=190000"

require conf/machine/include/gigablue-gbtrio4k.inc
```

## conf/machine/gbue4k.conf
```bitbake
#@TYPE: Machine
#@NAME: Gigablue UE 4k
#@DESCRIPTION: Machine configuration for the Gigablue UE 4k

SOC_FAMILY = "bcm7252s"
CHIPSET = "bcm7252s"

BRAND_OEM = "gigablue"
MACHINE_BRAND = "GigaBlue"
MACHINE_NAME = "UHD UE 4K"

FRIENDLY_FAMILY = "gb7252"
STB_PLATFORM = "gb7252"
MACHINE_MODEL = "gb7252"

KERNEL_FILE = "kernel.bin"
ROOTFS_FILE = "rootfs.tar.bz2"
MTD_BLACK = "mmcblk0"
MTD_BOOTFS = "mmcblk0p1"
MTD_ROOTFS = "mmcblk0p5"
MTD_KERNEL = "mmcblk0p4"

MACHINE_FEATURES += " HDMI skins1080 ci wlan mmc colorlcd220 gigabluelcd gigabluelcd400 blindscan-dvbs blindscan-dvbc transcoding streamproxy dvb-c GB-cortexa15 gb-eglfs"
OPENPLI_FEATURES += " kodi openhbbtvbrowser"
DISTRO_FEATURES:remove = "x11 wayland directfb"

IMAGEDIR ?= "gigablue/ue4k"

SRCDATE_BOLT = "20181120"

require conf/machine/include/gigablue-gb7252.inc
```

## conf/machine/include/gigablue-arm.inc
```bitbake
require conf/machine/include/gigablue.inc

TARGET_ARCH = "arm"
DEFAULTTUNE = "cortexa15hf-neon-vfpv4"
IMAGE_FSTYPES =+ "tar.bz2"

require conf/machine/include/arm/armv7a/tune-cortexa15.inc

DVBMEDIASINK_CONFIG = "--with-wma --with-wmv --with-amr --with-pcm --with-dts --with-eac3 --with-h265 --with-vb6 --with-vb8 --with-vb9 --with-spark \
"

PREFERRED_PROVIDER_virtual/blindscan-dvbc = "gigablue-blindscan-utils-arm"
PREFERRED_PROVIDER_virtual/blindscan-dvbs = "gigablue-blindscan-utils-arm"
PREFERRED_PROVIDER_virtual/egl = "gb-v3ddriver-${MACHINE_DRIVER}"
PREFERRED_PROVIDER_virtual/libgles2 = "gb-v3ddriver-${MACHINE_DRIVER}"
PREFERRED_PROVIDER_virtual/chromium-browser = "chromium-browser-gb7252"

require conf/machine/include/soc-family.inc
```

## conf/machine/include/gigablue.inc
```bitbake
KERNEL_MODULE_AUTOLOAD += "xfs"

# We know about rtc
MACHINE_FEATURES_BACKFILL_CONSIDERED = "rtc"

IMAGEVERSION := "${DISTRO_NAME}-${DISTRO_VERSION}-${DATE}"
IMAGEVERSION[vardepsexclude] = "DATE"

MACHINE_FEATURES += "3dtv alsa hdmicec switchoff"

MACHINE_DRIVER = "\
${@bb.utils.contains('MACHINE', 'gbquad4k', 'gb7252' , '', d)}\
${@bb.utils.contains('MACHINE', 'gbquad4kpro', 'gb7252pro' , '', d)}\
${@bb.utils.contains('MACHINE', 'gbue4k', 'gb7252' , '', d)}\
${@bb.utils.contains('MACHINE', 'gbtrio4k', 'gbtrio4k' , '', d)}\
${@bb.utils.contains('MACHINE', 'gbtrio4kpro', 'gbtrio4kpro' , '', d)}\
"
```
